/*
 * Copyright (c) 2006-2021, RT-Thread Development Team
 *
 * SPDX-License-Identifier: Apache-2.0
 *
 * Change Logs:
 * Date           Author       Notes
 * 2022-10-24     myshow       the first version
 */
#include <rtthread.h>

#include "fffeFrame.h"

#define DBG_TAG "fffe  "
#define DBG_LVL DBG_INFO
#include <rtdbg.h>

/*
 * This table was generated by the following program.
   #include <stdio.h>
   int
   main ()
   {
     unsigned int i, j;
     unsigned int c;
     int table[256];
     for (i = 0; i < 256; i++)
       {
     for (c = i << 24, j = 8; j > 0; --j)
       c = c & 0x80000000 ? (c << 1) ^ 0x04c11db7 : (c << 1);
     table[i] = c;
       }
     printf ("static const unsigned int crc32_table[] =\n{\n");
     for (i = 0; i < 256; i += 4)
       {
     printf ("  0x%08x, 0x%08x, 0x%08x, 0x%08x",
         table[i + 0], table[i + 1], table[i + 2], table[i + 3]);
     if (i + 4 < 256)
       putchar (',');
     putchar ('\n');
       }
     printf ("};\n");
     return 0;
   }
   For more information on CRC, see, e.g.,
   http://www.ross.net/crc/download/crc_v3.txt.
 */
static const uint32_t crc32_table[] =
{
    0x00000000, 0x04c11db7, 0x09823b6e, 0x0d4326d9,
    0x130476dc, 0x17c56b6b, 0x1a864db2, 0x1e475005,
    0x2608edb8, 0x22c9f00f, 0x2f8ad6d6, 0x2b4bcb61,
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    0xbcb4666d, 0xb8757bda, 0xb5365d03, 0xb1f740b4
};

/*
@deftypefn Extension {unsigned int} crc32 (const unsigned char *@var{buf}, @
  int @var{len}, unsigned int @var{init})
Compute the 32-bit CRC of @var{buf} which has length @var{len}.  The
starting value is @var{init}; this may be used to compute the CRC of
data split across multiple buffers by passing the return value of each
call as the @var{init} parameter of the next.
This is used by the @command{gdb} remote protocol for the @samp{qCRC}
command.  In order to get the same results as gdb for a block of data,
you must pass the first CRC parameter as @code{0xffffffff}.
This CRC can be specified as:
  Width  : 32
  Poly   : 0x04c11db7
  Init   : parameter, typically 0xffffffff
  RefIn  : false
  RefOut : false
  XorOut : 0
This differs from the "standard" CRC-32 algorithm in that the values
are not reflected, and there is no final XOR value.  These differences
make it easy to compose the values of multiple blocks.
@end deftypefn
*/
static uint32_t fffeFrame_xcrc32 (const uint8_t *buf, uint16_t len)
{
    LOG_D("  xcrc: %d", len);
    LOG_HEX("      xcrc", 16, (uint8_t *)buf, len);
    uint32_t crc = 0xffffffff;
    while (len--)
    {
        crc = (crc << 8) ^ crc32_table[((crc >> 24) ^ *buf) & 255];
        buf++;
    }
    return crc;
}

static uint16_t fffeFrame_code(uint8_t *buf, uint16_t len)
{
    LOG_D("  code: %d", len);
    LOG_HEX("      code", 16, buf, len);
    uint16_t isfind = 0;
    for (uint16_t i = 2;i < len - 2; )
    {
        if (buf[i] == 0xff)
        {
            if (isfind == 0)
            {
                rt_memmove(&buf[i + 2], &buf[i + 1], len - i - 1);
                buf[i + 1] = 0;
                isfind = i;
                len++;
                i += 2;
            }
            else if(i - isfind - 1 > 252)
            {
                rt_memmove(&buf[i + 2], &buf[i + 1], len - i - 1);
                buf[i + 1] = 0;
                isfind = i;
                len++;
                i += 2;
            }
            else
            {
                rt_memmove(&buf[i], &buf[i + 1], len - i - 1);
                buf[isfind + 1] = i - isfind - 1;
                isfind = 0;
                len--;
            }
        }
        else
        {
            i++;
        }
    }
    return len;
}

static uint16_t fffeFrame_uncode(uint8_t *buf, uint16_t len)
{
    LOG_D("uncode: %d", len);
    LOG_HEX("    uncode", 16, buf, len);
    uint16_t isfind = 0;
    for (uint16_t i = 2;i < len - 2; )
    {
        if (buf[i] == 0xff)
        {
            if (buf[i + 1] == 0)
            {
                rt_memmove(&buf[i + 1], &buf[i + 2], len - i - 1);
                len--;
                i++;
            }
            else
            {
                isfind = buf[i + 1];
                rt_memmove(&buf[i + 1], &buf[i + 2], len - i - 1);
                rt_memmove(&buf[i + isfind + 1], &buf[i + isfind], len - i - isfind - 1);
                buf[i + isfind] = 0xff;
                i += isfind + 1;
            }
        }
        else
        {
            i++;
        }
    }
    return len;
}

int16_t fffeFrame_init(fffeFrame *ff)
{
    ff->snCount = 0;
    ff->rx_len = 0;

    ff->tx_mutex = rt_mutex_create("tx_mutex", RT_IPC_FLAG_PRIO);
    if (ff->tx_mutex == RT_NULL)
    {
        LOG_E("mutex creat error!");
        return -RT_ENOMEM;
    }
    ff->rx_mutex = rt_mutex_create("rx_mutex", RT_IPC_FLAG_PRIO);
    if (ff->rx_mutex == RT_NULL)
    {
        LOG_E("mutex creat error!");
        return -RT_ENOMEM;
    }
    ff->rx_buffer = rt_malloc(ff->maxlen);
    if (ff->rx_buffer == RT_NULL)
    {
        LOG_E("buffer creat error!");
        return -RT_ENOMEM;
    }

    if (ff->init(ff) != RT_EOK)
    {
        LOG_E("init error!");
        return -RT_ERROR;
    }
    return RT_EOK;
}
RTM_EXPORT(fffeFrame_init);

int16_t fffeFrame_close(fffeFrame *ff)
{
    rt_mutex_delete(ff->tx_mutex);
    rt_mutex_delete(ff->rx_mutex);
    rt_free(ff->rx_buffer);

    if (ff->close(ff) != RT_EOK)
    {
        LOG_E("close error!");
        return -RT_ERROR;
    }
    return RT_EOK;
}
RTM_EXPORT(fffeFrame_close);

uint16_t fffeFrame_cmd(fffeFrame *ff, uint16_t cmd, const uint8_t *buffer, uint16_t size)
{
    rt_mutex_take(ff->tx_mutex, RT_WAITING_FOREVER);
    uint8_t framebuff[(size + sizeof(fffeFrameHead) + sizeof(fffeFrameEnd))*2];
    fffeFrameHead head = {
            .start = FFFEFRAME_START,
            .len = sizeof(framebuff)/2 - 4,
            .cmd = cmd,
            .sn = ff->snCount++,
    };
    rt_memcpy(framebuff, &head, sizeof(fffeFrameHead));
    rt_memcpy(&framebuff[sizeof(fffeFrameHead)], buffer, size);
    fffeFrameEnd end = {
            .check = fffeFrame_xcrc32(&framebuff[2], head.len - 4),
            .end = FFFEFRAME_END,
    };
    rt_memcpy(&framebuff[sizeof(fffeFrameHead) + size], &end, sizeof(fffeFrameEnd));

    size = fffeFrame_code(framebuff, sizeof(framebuff)/2);
    LOG_D("   cmd: %d", size);
    LOG_HEX("       cmd", 16, framebuff, size);

    if (ff->write(ff, framebuff, size) != size)
    {
        LOG_E("cmd error!");
        size = 0;
    }
    rt_mutex_release(ff->tx_mutex);
    return size;
}
RTM_EXPORT(fffeFrame_cmd);

uint16_t fffeFrame_ack(fffeFrame *ff, fffeFrame_Ack ack, uint16_t sn, uint16_t cmd, const uint8_t *buffer, uint16_t size)
{
    rt_mutex_take(ff->tx_mutex, RT_WAITING_FOREVER);
    uint8_t framebuff[(size + sizeof(fffeFrameHead) + sizeof(fffeFrameEnd))*2];
    fffeFrameHead head = {
            .start = FFFEFRAME_START,
            .len = sizeof(framebuff)/2 - 4,
            .cmd = cmd | ack,
            .sn = sn,
    };
    rt_memcpy(framebuff, &head, sizeof(fffeFrameHead));
    rt_memcpy(&framebuff[sizeof(fffeFrameHead)], buffer, size);
    fffeFrameEnd end = {
            .check = fffeFrame_xcrc32(&framebuff[2], head.len - 4),
            .end = FFFEFRAME_END,
    };
    rt_memcpy(&framebuff[sizeof(fffeFrameHead) + size], &end, sizeof(fffeFrameEnd));

    size = fffeFrame_code(framebuff, sizeof(framebuff)/2);
    LOG_D("   ack: %d", size);
    LOG_HEX("       ack", 16, framebuff, size);

    if (ff->write(ff, framebuff, size) != size)
    {
        LOG_E("ack error!");
        size = 0;
    }
    rt_mutex_release(ff->tx_mutex);
    return size;
}
RTM_EXPORT(fffeFrame_ack);

uint16_t fffeFrame_get_buffer_len(fffeFrameHead *head)
{
    return head->len + 4 - sizeof(fffeFrameHead) - sizeof(fffeFrameEnd);
}
RTM_EXPORT(fffeFrame_get_buffer_len);

int16_t fffeFrame_accept(fffeFrame *ff, uint16_t size)
{
    rt_mutex_take(ff->rx_mutex, RT_WAITING_FOREVER);
    uint16_t nblk = ((size % ff->maxlen) > 0)?(size/ff->maxlen + 1):(size/ff->maxlen);
    LOG_D("nblk  : %d %d %d", nblk, size, ff->maxlen);
    while (nblk > 0)
    {
        uint16_t nsize = 0;
        if (nblk == 1)
        {
            nsize = (size % ff->rx_len)?(size % ff->rx_len):(ff->rx_len);
        }
        else
        {
            nsize = ff->rx_len;
        }

        if (ff->rx_len + nsize > ff->maxlen)
        {
            LOG_E("Buffer size limit exceeded %d/%d", ff->rx_len + nsize, ff->maxlen);
        }
        uint16_t rx_length = ff->read(ff, ff->rx_buffer + ff->rx_len, nsize);
        if (rx_length  > 0)
        {
            LOG_D("accept: %d/%d", rx_length, nsize);
            LOG_HEX("    accept", 16, ff->rx_buffer + ff->rx_len, rx_length);
            ff->rx_len += rx_length;

            if (ff->rx_len >= sizeof(fffeFrameHead) + sizeof(fffeFrameEnd))
            {
                LOG_D("   get: %d", ff->rx_len);
                LOG_HEX("       get", 16, ff->rx_buffer, ff->rx_len);

                uint16_t mode = 0;
                uint16_t indexS = 0;
                uint16_t indexE = 0;
                uint16_t fffeLength = 0;
                for (uint16_t n = 0; n < ff->rx_len - 1; n++)
                {
                    uint16_t *pdata16 = (uint16_t *)&ff->rx_buffer[n];
                    uint16_t data16 = *pdata16;

                    fffeFrameHead *head = NULL;
                    fffeFrameEnd *end = NULL;
                    uint8_t *buffer = NULL;

                    if (data16 == FFFEFRAME_START)
                    {
                        mode = 1;
                        indexS = n;
                        n ++;
                        LOG_D("indexS: %d", indexS);
                    }
                    else if (mode == 1 && data16 == FFFEFRAME_END)
                    {
                        mode = 0;
                        indexE = n;
                        n ++;
                        LOG_D("indexE: %d", indexE);

                        fffeLength = indexE + 2 - indexS;
                        if (fffeLength >= sizeof(fffeFrameHead) + sizeof(fffeFrameEnd))
                        {
                            fffeLength = fffeFrame_uncode(&ff->rx_buffer[indexS], fffeLength);
                            LOG_D("buffer: %d", fffeLength);
                            LOG_HEX("    buffer", 16, &ff->rx_buffer[indexS], fffeLength);
                            head = (fffeFrameHead *)&ff->rx_buffer[indexS];
                            LOG_D("  head: %x %d %x %d", head->start, head->len, head->cmd, head->sn);
                            if (head->len == fffeLength - 4)
                            {
                                buffer = &ff->rx_buffer[indexS + sizeof(fffeFrameHead)];
                                end = (fffeFrameEnd *)&ff->rx_buffer[indexS + fffeLength - sizeof(fffeFrameEnd)];
                                LOG_D("   end: %x %x", end->check, end->end);
                                uint32_t crc32 = fffeFrame_xcrc32((uint8_t *)head + 2, head->len - 4);
                                if (end->check == crc32)
                                {
                                    if (head->len > ff->maxlen)
                                    {
                                        LOG_E("Please set a longer maximum length %d/%d.", head->len, ff->maxlen);
                                    }
                                    ff->rx_indicate(ff, head, buffer, end);
                                }
                                else
                                {
                                    LOG_D("   crc: error %x %x", end->check, crc32);
                                }
                            }
                            else
                            {
                                LOG_D("   len: error %d %d", head->len, fffeLength - 4);
                            }
                        }
                    }
                }
                uint16_t lessindex = ff->rx_len;
                if (indexS != 0 || indexE != 0)
                {
                    lessindex = (indexE > indexS)?(indexE + 2):(indexS);
                }
                uint16_t lessLength = ff->rx_len - lessindex;
                rt_memcpy(ff->rx_buffer, &ff->rx_buffer[lessindex], lessLength);
                ff->rx_len = lessLength;
                LOG_D("  less: %d", ff->rx_len);
                LOG_HEX("    less", 16, ff->rx_buffer, ff->rx_len);
            }
        }

        nblk -- ;
    }
    rt_mutex_release(ff->rx_mutex);

    return 0;
}
RTM_EXPORT(fffeFrame_accept);
