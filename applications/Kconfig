## applications/Kconfig
```kconfig
menu "Test functions and examples"
    config BSP_USING_FS_TEST
        bool "Enable file system read and write speed test command"
        default n
        
    config BSP_USING_MTD_NOR_TEST
        bool "Enable mtd nor device read and write speed test command"
        default n
        
    config BSP_USING_TERMIOS_EXAMPLE
        bool "Enable termios echo test example"
        default n
        
    config BSP_TERMIOS_EXAMPLE_DEVNAME
        string "Set the device address used, default : /dev/uart7"
        depends on BSP_USING_TERMIOS_EXAMPLE
        default "/dev/uart7"
        
    config BSP_USING_UART_EXAMPLE
        bool "Enable uart echo test example"
        default n
        
    config BSP_UART_EXAMPLE_DEVNAME
        string "Set the device name used, default : uart7"
        depends on BSP_USING_UART_EXAMPLE
        default "uart7"
        
    config BSP_USING_TERMIOS_TEST
        bool "Enable termios test command"
        default n
        
    config BSP_USING_UART_TEST
        bool "Enable uart test command"
        default n
        
    config BSP_USING_CAN_TEST
        bool "Enable can test command"
        default n
        
    config BSP_USING_TINYFRAME_EXAMPLE
        bool "Enable tinyframe test example"
        default n
        
    config BSP_TINYFRAME_EXAMPLE_DEVNAME
        string "Set the device address used, default : uart7"
        depends on BSP_USING_TINYFRAME_EXAMPLE
        default "uart7"

    config BSP_USING_ADC_EXAMPLE
        bool "Enable adc example"
        default n
        
    config BSP_USING_LTC2945_EXAMPLE
        bool "Enable ltc2945 example"
        default n
        
    config BSP_USING_LTC2991_EXAMPLE
        bool "Enable ltc2991 example"
        default n
        
    config BSP_USING_DS1682_EXAMPLE
        bool "Enable ds1682 example"
        default n
        
    config BSP_USING_MAX31826_EXAMPLE
        bool "Enable max31826 example"
        default n
        
    config BSP_USING_DS28E01_EXAMPLE
        bool "Enable ds28e01 example"
        default n
        
    config BSP_USING_CMSISOS2_EXAMPLE
        bool "Enable cmsis os2 example"
        default n
        
    menuconfig BSP_USING_NET_EXAMPLE
        bool "Enable net example"
        default n
        
        if BSP_USING_NET_EXAMPLE
            config BSP_USING_NET_TEST
                bool "Enable net test"
                default n
    
            config BSP_USING_TCP_CLIENT
                bool "Enable tcp client"
                default n
                
            config BSP_USING_TCP_SERVER
                bool "Enable tcp server"
                default n
                
            config BSP_USING_UDP_CLIENT
                bool "Enable udp client"
                default n
                
            config BSP_USING_UDP_SERVER
                bool "Enable udp server"
                default n
        endif
        
    config BSP_USING_DSP_EXAMPLE
        bool "Enable cmsis dsp example"
        select PKG_USING_CMSIS_5
        select PKG_CMSIS_DSP
        default n
        
    menuconfig BSP_USING_LINK_LAYER_COMM_TEST
        bool "Enable link layer comm test"
        default n
        
        if BSP_USING_LINK_LAYER_COMM_TEST
            config BSP_USING_LINK_LAYER_CHANNEL_1
                bool "link layer comm channel 1 enable"
                default n
            config BSP_USING_LINK_LAYER_CHANNEL_2
                bool "link layer comm channel 2 enable"
                default n
            config BSP_USING_LINK_LAYER_CHANNEL_3
                bool "link layer comm channel 3 enable"
                default n
        endif
endmenu

menu "Product Application and Function"
    source "applications/selftest/Kconfig"
    source "applications/cable_test_bench/Kconfig"
    source "applications/coupler_controller/Kconfig"
    source "applications/ly_05c/Kconfig"
    source "applications/sto_record_board/Kconfig"
    
endmenu
```

## applications/TPX86_voice_ctrl/Kconfig
```kconfig
config APP_TPX86_VOICE_CTRL
    bool "Enable TPX86 voice ctrl application"
    select PKG_USING_WAVPLAYER
    default n
    
if APP_TPX86_VOICE_CTRL

endif
```

## applications/cable_test_bench/Kconfig
```kconfig
config APP_CABLE_TEST_BENCH
    bool "Enable cable test bench application"
    default n
```

## applications/conformance_test_of_trdp/Kconfig
```kconfig
config APP_USING_TRDP_PD_CONFORMANCE_TEST
    bool "Enable conformance test of trdp"
    default n
    
    if APP_USING_TRDP_PD_CONFORMANCE_TEST
        config APP_USING_TRDP_PD_CONFORMANCE_PUSH_PATTERN_TELEGRAM_TEST
            bool "Push pattern telegram test"
            default n
        config APP_USING_TRDP_PD_CONFORMANCE_DEST_UDP_PORT_TEST
            bool "Destination UDP port test"
            default n
        config APP_USING_TRDP_PD_DATA_LENGTH_TEST
            bool "Data length test"
            default n
        config APP_USING_TRDP_PD_BYTE_ALIGNMENT_TEST
            bool "Byte alignment test"
            default n
        config APP_USING_TRDP_PD_POINT_TO_POINT_TEST
            bool "Point to point test"
            default n
        config APP_USING_TRDP_PD_TIMEOUT_AND_VALIDITY_TEST
            bool "Timeout and validity test"
            default n
        config APP_USING_TRDP_PD_TOPOLOGY_COUNTER_TEST
            bool "Topology counter test"
            default n
        config APP_USING_TRDP_PD_FCS_CHECK_TEST
            bool "FCS check test"
            default n
        config APP_USING_TRDP_PD_PROTOCOL_VERSION_TEST
            bool "Protocol version test"
            default n
    endif
```

## applications/coupler_controller/Kconfig
```kconfig
config APP_COUPLER_CONTROLLER
    bool "Enable coupler controller application"
    default n
    
if APP_COUPLER_CONTROLLER
    config COUPLER_CONTROLLER_OLD
        bool "Enable old version compatibility"
        default n
endif
```

## applications/ly_05c1_test/Kconfig
```kconfig
config APP_LY_05C1_TEST
    bool "Enable LY-05C1 test application"
    default n
```

## applications/sto_Com2LoardBoard/Kconfig
```kconfig
config APP_STO_COM_2_LOARD_BOART
    bool "Enable STO-COM_2_LOARD-BOARD application"
    default n
```

## applications/sto_com_board/Kconfig
```kconfig
config APP_STO_COM_BOARD
    bool "Enable STO-COM-BOARD application"
    default n
        
    if APP_STO_COM_BOARD
        config HAL_OS_USE_RT_THREAD_LOG
            bool "Enable rtthread log"
            default y

        config HAL_OS_THREAD_TIMESLICE
            int "Set thread time slice, default(5)"
            default 5

        config HAL_OS_FMT_BUF_SIZE
            int "Set printf buf size, default(1024 * 2)"
            default 2048
    endif
	
```

## applications/sto_record_board/Kconfig
```kconfig
config APP_STO_RECORD_BOART
    bool "Enable STO-RECORD-BOARD application"
    default n
```

## packages/Kconfig
```kconfig
menuconfig PKG_USING_FFFEFRAME
    bool "Enable FF-FE serial communication protocol framework"
    default n
    
    if PKG_USING_FFFEFRAME
        config PKG_FFFEFRAME_USING_EXAMPLE
            bool "Enable FF-FE serial communication protocol framework example"
            default n
            
        config PKG_FFFEFRAME_EXAMPLE_DEVNAME
            string "Set the device address used, default : uart7"
            depends on PKG_FFFEFRAME_USING_EXAMPLE
            default "uart7"
    endif
    
menuconfig PKG_USING_HDLC7c7eFRAME
    bool "Enable hdlc 7c7e serial communication protocol framework"
    default n
    
    if PKG_USING_HDLC7c7eFRAME
        config PKG_HDLC7c7eFRAME_USING_EXAMPLE
            bool "Enable hdlc 7c7e serial communication protocol framework example"
            default n
            
        config PKG_HDLC7c7eFRAME_EXAMPLE_DEVNAME
            string "Set the device address used, default : uart7"
            depends on PKG_HDLC7c7eFRAME_USING_EXAMPLE
            default "uart7"
    endif
    
menuconfig PKG_USING_SYSINFO
    bool "Enable systerm info"
    default n
    
    if PKG_USING_SYSINFO
        config SYSINFO_PARTNAME
            string "Set the partition name used, default : max31826"
            default "max31826"
            
        config SYSINFO_PARTSIZE
            int "Set the partition size, default: 128"
            default (128)
    endif

menuconfig PKG_USING_ULOG_BACK
    bool "Enable the ulog backend"
    select RT_USING_ULOG
    default n
    
    if PKG_USING_ULOG_BACK
        choice
            prompt "Select the output mode of the ulog backend"
            default ULOG_BACK_USING_FILE
            
            config ULOG_BACK_USING_FILE
                bool "Enable the ulog file"
                select ULOG_BACKEND_USING_FILE
                
            config ULOG_BACK_USING_TSDB
                bool "Enable the ulog tsdb"
                select PKG_USING_FLASHDB_PORT
                
            config ULOG_BACK_USING_TSDB_FILE
                bool "Enable the ulog tsdb file"
                select PKG_USING_FLASHDB_PORT
        endchoice

        config ULOG_BACK_DIR_PATH
            string "Set the ulog output dir path, default: /mnt/emmc/ulog"
            depends on ULOG_BACK_USING_FILE
            default "/mnt/emmc/ulog"

        config ULOG_BACK_FILE_MAX_NUM
            int "Set the ulog file max num, default: 16"
            depends on ULOG_BACK_USING_FILE
            default (16)
            
        config ULOG_BACK_FILE_MAX_SIZE
            int "Set the ulog file max size, must be larger than buf size, default: 512 * 1024"
            depends on ULOG_BACK_USING_FILE
            default (524288)
            
        config ULOG_BACK_FILE_BUF_SIZE
            int "Set the ulog file buf size, default: 512"
            depends on ULOG_BACK_USING_FILE
            default (512)
    endif
    
menuconfig PKG_USING_FLASHDB_PORT
    bool "Enable the FlashDB port support"
    select PKG_USING_FLASHDB
    default n
    
    if PKG_USING_FLASHDB_PORT
        config FLASHDB_PORT_USING_KVDB
            bool "Enable kvdb"
            select FDB_USING_KVDB
            default y
            
        config FLASHDB_PORT_KVDB_PARTNAME
            string "Set the FlashDB kvdb part name, default: kvdb"
            depends on FLASHDB_PORT_USING_KVDB
            default "kvdb"
            
        config FLASHDB_PORT_USING_TSDB
            bool "Enable tsdb"
            select FDB_USING_TSDB
            default n
            
        config FLASHDB_PORT_TSDB_PARTNAME
            string "Set the FlashDB tsdb part name, default: tsdb"
            depends on FLASHDB_PORT_USING_TSDB
            default "tsdb"
    endif
    
menuconfig PKG_USING_AMRPLAYER
    bool "Enable amrplayer library"
    select PKG_USING_OPTPARSE
    select PKG_USING_3GPP_AMRNB
    default n
    
    if PKG_USING_AMRPLAYER
        config AMRPLAYER_USING_PLAY
            bool "Enable audio playback"
            default n
            
        config AMRPLAYER_PLAY_DEVICE
            string "Set audio playback device, default: sound0"
            depends on AMRPLAYER_USING_PLAY
            default "sound0"
            
        config AMRPLAYER_USING_RECORD
            bool "Enable audio record"
            default n
            
        config AMRPLAYER_RECORD_DEVICE
            string "Set audio record device, default: sound0"
            depends on AMRPLAYER_USING_RECORD
            default "sound0"
    endif
    
menuconfig PKG_USING_MPY_PORT
    bool "Enable MicroPython library"
    select PKG_USING_MICROPYTHON
    default n
    
    if PKG_USING_MPY_PORT
        config MPY_PORT_WORKING_DIR
            string "Set working directory, default: /mnt/nor"
            default "/mnt/nor"
            
        config MPY_PORT_USING_EXEC_DEFAULT
            bool "Set MicroPython automatically execute the default script"
            default n
            
        config MPY_PORT_DEFAULT_SCRIPT
            string "Set default script, default: /mnt/nor/main.py"
            depends on MPY_PORT_USING_EXEC_DEFAULT
            default "/mnt/nor/main.py"
            
        config MPY_PORT_USING_SELF_STARTING
            bool "Set MicroPython self-starting"
            default n
    endif
    
menuconfig PKG_USING_OTA_FROM_FILE
    bool "Enable ota from file library"
    select PKG_USING_CRCLIB
    default n
    
    if PKG_USING_OTA_FROM_FILE
        config OTA_FROM_FILE_DOWNLOAD_PART_NAME
            string "Set download part name, default: download"
            default "download"
            
        config OTA_FROM_FILE_FACTORY_PART_NAME
            string "Set factory part name, default: factory"
            default "factory"
            
        config OTA_FROM_FILE_DEVNAME
            string "Set storage device name, default: ud0p0"
            default "ud0p0"
            
        config OTA_FROM_FILE_DOWNLOAD_PATH
            string "Set firmware path, default: /mnt/udisk/ud0p0/download.rbl"
            default "/mnt/udisk/ud0p0/download.rbl"
            
        config OTA_FROM_FILE_FACTORY_PATH
            string "Set firmware path, default: /mnt/udisk/ud0p0/factory.rbl"
            default "/mnt/udisk/ud0p0/factory.rbl"
    endif
    
```

## packages/sysinfo/Kconfig
```kconfig
menuconfig PKG_USING_SYSINFO
    bool "Enable systerm info"
    select BSP_USING_CPUTEMP
    select BSP_USING_MAX31826
    select BSP_USING_DS1682
    default n
    
    if PKG_USING_SYSINFO
        config SYSINFO_CPU_TEMP_NAME
            string "Set the cpu temp device name, default : temp_cpu"
            default "temp_cpu"
            
        config SYSINFO_CHIP_TEMP_NAME
            string "Set the chip temp device name, default : temp_max31826"
            default "temp_max31826"
            
        config SYSINFO_TIMES_DEV_NAME
            string "Set the times device name, default : ds1682"
            default "ds1682"
            
        config SYSINFO_PARTNAME
            string "Set the partition name used, default : max31826"
            default "max31826"
            
        config SYSINFO_PARTSIZE
            int "Set the partition size, default: 128"
            default (128)
    endif
```

## packages/trdp/Kconfig
```kconfig
menuconfig PKG_USING_TRDP
    bool "Enable trdp"
    default n

    if PKG_USING_TRDP
        config MD_SUPPORT
            int "Disable Message-Data, default: 0"
            default 0
    endif
```
