/*******************************************************************************************
                                file information
********************************************************************************************
**@file  : support_libCRC_.c
**@author: Created By Chengt
**@date  : 2019.12.13
**@brief : Implement the function interfaces of support_libCRC
********************************************************************************************/
#include "support_libCRC.h"

/*******************************************************************************************
 *        Local definitions
 *******************************************************************************************/

/*******************************************************************************************
 *        Local variables
 *******************************************************************************************/
/* crc table */

const uint8 CRC8_Table[]=
{
  0, 94, 188, 226, 97, 63, 221, 131, 194, 156, 126, 32, 163, 253, 31, 65,
  157, 195, 33, 127, 252, 162, 64, 30, 95, 1, 227, 189, 62, 96, 130, 220,
  35, 125, 159, 193, 66, 28, 254, 160, 225, 191, 93, 3, 128, 222, 60, 98,
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  116, 42, 200, 150, 21, 75, 169, 247, 182, 232, 10, 84, 215, 137, 107, 53
};

static const uint16 crctab16[] = 
{
    0x0000, 0x1189, 0x2312, 0x329b, 0x4624, 0x57ad, 0x6536, 0x74bf,
    0x8c48, 0x9dc1, 0xaf5a, 0xbed3, 0xca6c, 0xdbe5, 0xe97e, 0xf8f7,
    0x1081, 0x0108, 0x3393, 0x221a, 0x56a5, 0x472c, 0x75b7, 0x643e,
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    0x7bc7, 0x6a4e, 0x58d5, 0x495c, 0x3de3, 0x2c6a, 0x1ef1, 0x0f78,
};

const uint16 CRC16_TableF0[256]=
{
    0x0000, 0x1021, 0x2042, 0x3063, 0x4084, 0x50a5, 0x60c6, 0x70e7,
    0x8108, 0x9129, 0xa14a, 0xb16b, 0xc18c, 0xd1ad, 0xe1ce, 0xf1ef,
    0x1231, 0x0210, 0x3273, 0x2252, 0x52b5, 0x4294, 0x72f7, 0x62d6,
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    0x6e17, 0x7e36, 0x4e55, 0x5e74, 0x2e93, 0x3eb2, 0x0ed1, 0x1ef0
};
/*********************************************   CRC16 = X16+X15+X2+1    8005     A001  ***************************/

const uint16 crctalbeabs[] = 
{
	0x40bf,0x70c0,0x91f1,0x8510,0x0f85,0xa00e,0xc6a1,0x7a46,
	0x34fa,0x4574,0x20c5,0x94a1,0xbd55,0xfabc,0x757a,0xe7b4,
    0xbbe6,0x86fa,0x4e86,0x6f8e,0x6bef,0x43eb,0x8182,0x6f41,
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	0x81ea,0xcdc0,0x134d,0xb692,0xec37,0x576c,0xadd6,0xde6c,
};

/*******************************************************************************************
 ** @brief: support_timer_timeoutMN
 ** @param: pData, nLength
 *******************************************************************************************/
extern uint8 support_crc8( const uint8* pData, uint32 nLength )
{ 
    uint8 t_crc_value = 0;

    for( ; nLength > 0; nLength--)
    {
        t_crc_value = CRC8_Table[t_crc_value^*pData];
        pData++;
    }
    return(t_crc_value);
}

/*******************************************************************************************
 ** @brief: support_crc16
 ** @param: pData, nLength
 *******************************************************************************************/
extern uint16 support_crc16( const uint8* pData, uint32 nLength )
{
	uint16 crc16 = 0;
	uint32 k =0 ;
	
	while(nLength > 0)
	{
		k = (crc16 ^ *pData) & 0xff;
		crc16 = (crc16 >> 8) ^ crctab16[k];
		nLength--;
		pData++;
	}
	return (~crc16);
}
/*******************************************************************************************
 ** @brief: crc16_X16125
 ** @param: pData, nLength, crc_init
 *******************************************************************************************/
static uint16 crc16_X16125( const uint8* pData, uint32 nLength, uint16 crc_init )
{
	uint16 crc16 = 0;
	uint32 k =0 ;
	crc16 = crc_init;
	while(nLength > 0)
	{
		k = (crc16 ^ *pData) & 0xff;
		crc16 = (crc16 >> 8) ^ crctab16[k];
		nLength--;
		pData++;
	}
	return (~crc16);
}
/*******************************************************************************************
 ** @brief: crc16_X16152
 ** @param: pData, nLength, crc_init
 *******************************************************************************************/
static uint16 crc16_X16152( uint8 *pData,uint32 nLength, uint16 crc_init )
{
	uint16 a = 0,b = 0,v = 0,CRC_16=0xFFFF;//CRC初值
	 
	CRC_16 = crc_init;
	for(a =0;a < nLength;a++)
	{
		CRC_16 ^= pData[a];
		for(b =0;b <8;b++)
		{
			if(CRC_16&0x01)
			{
				CRC_16 = CRC_16 >> 1;
				CRC_16 = CRC_16 ^ 0xA001;
			}
			else
			{
				CRC_16 = CRC_16 >> 1;
			}
		 }
	 }
	 v = ((CRC_16 & 0x00ff) << 8) | ((CRC_16 & 0xff00) >> 8);
	 return v;
}

/*******************************************************************************************
 ** @brief: crc16_X16125_tabF0
 ** @param: p_data, p_len, p_crc_init
 *******************************************************************************************/
static uint16 crc16_X16125_tabF0(uint8 *p_data, uint16 p_len, uint16 p_crc_init )
{    
	uint16 t_crc_value = 0;
    uint8  t_data;

    t_crc_value = p_crc_init;
   
    while(p_len-- != 0)
	{
    	t_data=(uint16)t_crc_value>>8;
        t_crc_value<<=8;
        t_crc_value^=CRC16_TableF0[t_data^*p_data];
        p_data++;
    }
    return (t_crc_value);
}

/*******************************************************************************************
 ** @brief: crc16_X16125_tabF0
 ** @param: p_data, p_len, p_crc_init
 *******************************************************************************************/
static uint16 crc16_XMODEM( uint8* databuff,uint16 length )
{
	uint16 crc = 0U;
	uint16 poly = 0x1021U;
	uint16 i = 0U;
	uint8 j = 0U;

	for( i = 0U; i < length; i++ )
	{
		crc = crc^((*(databuff+i))<<8U);
		for( j = 0U; j < 8U; j++ )
		{
			if(crc&0x8000)
			{
				crc = (crc<<1U)^poly;
			}
			else
			{
				crc = crc<<1U;
			}
		}
	}

	return crc;
}
/*******************************************************************************************
 ** @brief: support_crc16Type
 ** @param: crcType, pData, nLength, crc_init
 *******************************************************************************************/
extern uint16 support_crc16Type(E_CRC16_TYPE crcType, uint8 *pData, uint32 nLength, uint16 crc_init )
{
    uint16 v = 0;

    if( CRC16_TYPE_16152 == crcType )
	{
    	v = crc16_X16152( pData, nLength, crc_init );
	}
	else if( CRC16_TYPE_16125 == crcType )
	{
		v = crc16_X16125( pData, nLength, crc_init );
	}
	else if( CRC16_TYPE_16125_Tabf0 == crcType )
	{
		v = crc16_X16125_tabF0( pData, nLength, crc_init );
	}
	else if( CRC16_TYPE_XMODEM == crcType )
	{
		v = crc16_XMODEM( pData, nLength );
	}
	else
	{

	}
    return v;
}

/*******************************************************************************************
 ** @brief: support_timer_timeoutMN
 ** @param: *timer_info, ms
 *******************************************************************************************/
extern uint32 support_crc32( const uint8* pData, uint32 nLength )
{
	uint32 crc32 = 0;
	return crc32;
}
/**************************************end file*********************************************/
